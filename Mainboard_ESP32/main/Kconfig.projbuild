## Mainboard_ESP32/main/Kconfig.projbuild
```kconfig
menu "ROSALIA v1.0 board Config"

    config D0_LORA
        int "D0_LORA pin number"
        default 2
        help
            GPIO pin number for D0_LORA.

    config RS_LORA
        int "RS_LORA pin number"
        default 4
        help
            GPIO pin number for RS_LORA.

    config CS_LORA
        int "CS_LORA pin number"
        default 5
        help
            GPIO pin number for CS_LORA.

    config TDI
        int "TDI pin number"
        default 12
        help
            GPIO pin number for TDI.

    config TCK
        int "TCK pin number"
        default 13
        help
            GPIO pin number for TCK.

    config TMS
        int "TMS pin number"
        default 14
        help
            GPIO pin number for TMS.

    config TDO
        int "TDO pin number"
        default 15
        help
            GPIO pin number for TDO.

    config IGN
        int "IGN pin number"
        default 16
        help
            GPIO pin number for IGN.

    config ARM
        int "ARM pin number"
        default 17
        help
            GPIO pin number for ARM.

    config SPI_SCK
        int "SPI_SCK pin number"
        default 18
        help
            GPIO pin number for SPI_SCK.

    config SPI_MISO
        int "SPI_MISO pin number"
        default 19
        help
            GPIO pin number for SPI_MISO.

    config SPI_MOSI
        int "SPI_MOSI pin number"
        default 23
        help
            GPIO pin number for SPI_MOSI.

    config I2C_SDA
        int "I2C_SDA pin number"
        default 21
        help
            GPIO pin number for I2C_SDA.

    config I2C_SCL
        int "I2C_SCL pin number"
        default 22
        help
            GPIO pin number for I2C_SCL.

    config CS_FLASH
        int "CS_FLASH pin number"
        default 26
        help
            GPIO pin number for CS_FLASH.

    config CS_SD
        int "CS_SD pin number"
        default 26
        help
            GPIO pin number for CS_SD.

    config STATUS_LED
        int "STATUS_LED pin number"
        default 27
        help
            GPIO pin number for STATUS_LED.

    config PWM1
        int "PWM1 pin number"
        default 32
        help
            GPIO pin number for PWM1.

    config PWM2
        int "PWM2 pin number"
        default 33
        help
            GPIO pin number for PWM2.

    config LIM2_1
        int "LIM2_1 pin number"
        default 34
        help
            GPIO pin number for LIM2_1.

    config LIM2_2
        int "LIM2_2 pin number"
        default 35
        help
            GPIO pin number for LIM2_2.

    config LIM1_1 
        int "LIM1_1 pin number"
        default 36
        help
            GPIO pin number for LIM1_1.

    config LIM1_2
        int "LIM1_2 pin number"
        default 39
        help
            GPIO pin number for LLIM1_2.

endmenu

menu "ROSALIA v2.0 board Config ESP32S3"

    config A_CAN
        int "A_CAN pin number"
        default 1
        help
            GPIO pin number for A_CAN
    
    config A_VBAT
        int "A_VBAT pin number"
        default 2
        help
            GPIO pin number for A_VBAT
    
    config A_ADJV
        int "A_ADJV pin number"
        default 4
        help
            GPIO pin number for A_ADJV

    config IGNIT_CONT
        int "IGNIT_CONT pin number"
        default 5
        help
            GPIO pin number for IGNIT_CONT.

    config TURN_OFF
        int "TURN_OFF pin number"
        default 6
        help
            GPIO pin number for TURN_OFF.

    config ARM
        int "ARM pin number"
        default 7
        help
            GPIO pin number for ARM.

    config I2C_SDA
        int "I2C_SDA pin number"
        default 8
        help
            GPIO pin number for I2C_SDA.

    config I2C_SCL
        int "I2C_SCL pin number"
        default 9
        help
            GPIO pin number for I2C_SCL.

    config LORA_CS
        int "LORA_CS pin number"
        default 10
        help
            GPIO pin number for LORA_CS.

    config SPI_MOSI
        int "SPI_MOSI pin number"
        default 11
        help
            GPIO pin number for SPI_MOSI.

    config SPI_SCK
        int "SPI_SCK pin number"
        default 12
        help
            GPIO pin number for SPI_SCK.

    config SPI_MISO
        int "SPI_MISO pin number"
        default 13
        help
            GPIO pin number for SPI_MISO.

    config SD_CS
        int "SD_CS pin number"
        default 14
        help
            GPIO pin number for SD_CS.

    config FIRE_1
        int "FIRE_1 pin number"
        default 15
        help
            GPIO pin number for FIRE_1.
    
    config FIRE_2
        int "FIRE_2 pin number"
        default 16
        help
            GPIO pin number for FIRE_2.

    config UART_1_TX
        int "UART_1_TX pin number"
        default 17
        help
            GPIO pin number for UART_1_TX.
    
    config UART_1_RX
        int "UART_1_RX pin number"
        default 18
        help
            GPIO pin number for UART_1_RX.
    
    config USB_D_N
        int "USB_D_N pin number"
        default 19
        help
            GPIO pin number for USB_D_N.
    
    config USB_D_P
        int "USB_D_P pin number"
        default 20
        help
            GPIO pin number for USB_D_P.

    config FLASH_CS
        int "FLASH_CS pin number"
        default 21
        help
            GPIO pin number for FLASH_CS.

    config LED_K_G
        int "LED_K_G pin number"
        default 35
        help
            GPIO pin number for LED_K_G.

    config LED_K_R
        int "LED_K_R pin number"
        default 36
        help
            GPIO pin number for LED_K_R.

    config LED_K_B
        int "LED_K_B pin number"
        default 37
        help
            GPIO pin number for LED_K_B.
    
    config LORA_RS
        int "LORA_RS pin number"
        default 38
        help
            GPIO pin number for LORA_RS.

    config LORA_D0
        int "LORA_D0 pin number"
        default 39
        help
            GPIO pin number for LORA_D0.

    config SD_CS
        int "SD_CS pin number"
        default 40
        help
            GPIO pin number for SD_CS.

    config BUZZER
        int "BUZZER pin number"
        default 41
        help
            GPIO pin number for BUZZER.
    
    config STATUS_LED
        int "STATUS_LED pin number"
        default 42
        help
            GPIO pin number for STATUS_LED.

    config EXP2
        int "EXP2 pin number"
        default 47
        help
            GPIO pin number for EXP2.

    config EXP1
        int "EXP1 pin number"
        default 48
        help
            GPIO pin number for EXP1.

endmenu
```

## Mainboard_ESP32/test/main/Kconfig.projbuild
```kconfig
menu "ROSALIA v1.0 board Config"

    config D0_LORA
        int "D0_LORA pin number"
        default 2
        help
            GPIO pin number for D0_LORA.

    config RS_LORA
        int "RS_LORA pin number"
        default 4
        help
            GPIO pin number for RS_LORA.

    config CS_LORA
        int "CS_LORA pin number"
        default 5
        help
            GPIO pin number for CS_LORA.

    config TDI
        int "TDI pin number"
        default 12
        help
            GPIO pin number for TDI.

    config TCK
        int "TCK pin number"
        default 13
        help
            GPIO pin number for TCK.

    config TMS
        int "TMS pin number"
        default 14
        help
            GPIO pin number for TMS.

    config TDO
        int "TDO pin number"
        default 15
        help
            GPIO pin number for TDO.

    config IGN
        int "IGN pin number"
        default 16
        help
            GPIO pin number for IGN.

    config ARM
        int "ARM pin number"
        default 17
        help
            GPIO pin number for ARM.

    config SPI_SCK
        int "SPI_SCK pin number"
        default 18
        help
            GPIO pin number for SPI_SCK.

    config SPI_MISO
        int "SPI_MISO pin number"
        default 19
        help
            GPIO pin number for SPI_MISO.

    config SPI_MOSI
        int "SPI_MOSI pin number"
        default 23
        help
            GPIO pin number for SPI_MOSI.

    config I2C_SDA
        int "I2C_SDA pin number"
        default 21
        help
            GPIO pin number for I2C_SDA.

    config I2C_SCL
        int "I2C_SCL pin number"
        default 22
        help
            GPIO pin number for I2C_SCL.

    config CS_FLASH
        int "CS_FLASH pin number"
        default 26
        help
            GPIO pin number for CS_FLASH.

    config CS_SD
        int "CS_SD pin number"
        default 26
        help
            GPIO pin number for CS_SD.

    config STATUS_LED
        int "STATUS_LED pin number"
        default 27
        help
            GPIO pin number for STATUS_LED.

    config PWM1
        int "PWM1 pin number"
        default 32
        help
            GPIO pin number for PWM1.

    config PWM2
        int "PWM2 pin number"
        default 33
        help
            GPIO pin number for PWM2.

    config LIM2_1
        int "LIM2_1 pin number"
        default 34
        help
            GPIO pin number for LIM2_1.

    config LIM2_2
        int "LIM2_2 pin number"
        default 35
        help
            GPIO pin number for LIM2_2.

    config LIM1_1 
        int "LIM1_1 pin number"
        default 36
        help
            GPIO pin number for LIM1_1.

    config LIM1_2
        int "LIM1_2 pin number"
        default 39
        help
            GPIO pin number for LLIM1_2.

endmenu
```

## Mainboard_ESP32/test/sdkconfig.defaults
```kconfig
CONFIG_BT_ENABLED=y
CONFIG_IDF_TARGET="esp32s3"

# CONFIG_BT_BLE_50_FEATURES_SUPPORTED=n not set
CONFIG_BT_BLE_42_FEATURES_SUPPORTED=y
CONFIG_BT_LE_50_FEATURE_SUPPORT=n
CONFIG_ESPTOOLPY_FLASHSIZE_8MB=y
CONFIG_ESPTOOLPY_FLASHSIZE_2MB=n

CONFIG_PARTITION_TABLE_CUSTOM=y
CONFIG_PARTITION_TABLE_CUSTOM_FILENAME="partitions.csv"
CONFIG_PARTITION_TABLE_FILENAME="partitions.csv"
```
